## image/Config.in
```kconfig
menu "mestro kiosk image"

source "$BR2_EXTERNAL_MESTROIMAGE_PATH/package/font-inter/Config.in"
source "$BR2_EXTERNAL_MESTROIMAGE_PATH/package/font-material-symbols/Config.in"
source "$BR2_EXTERNAL_MESTROIMAGE_PATH/package/mestro/Config.in"

endmenu
```

## image/package/font-inter/Config.in
```kconfig
config BR2_PACKAGE_FONT_INTER
	bool "font-inter"
	help
	  Inter — the text typeface of the kiosk UI (OFL). Installs
	  the variable TTF that board/mestro/common/fonts.conf expects.

	  https://rsms.me/inter/
```

## image/package/font-material-symbols/Config.in
```kconfig
config BR2_PACKAGE_FONT_MATERIAL_SYMBOLS
	bool "font-material-symbols"
	help
	  Material Symbols — the icon font of the kiosk UI
	  (Apache-2.0). Installs the outlined variable TTF that
	  board/mestro/common/fonts.conf expects.

	  https://fonts.google.com/icons
```

## image/package/mestro/Config.in
```kconfig
config BR2_PACKAGE_MESTRO
	bool "mestro"
	depends on BR2_aarch64
	depends on BR2_PACKAGE_HAS_UDEV
	depends on BR2_PACKAGE_HAS_LIBGBM
	depends on BR2_PACKAGE_HOST_RUSTC_TARGET_ARCH_SUPPORTS
	select BR2_PACKAGE_HOST_RUSTC
	select BR2_PACKAGE_SEATD
	select BR2_PACKAGE_LIBXKBCOMMON
	select BR2_PACKAGE_LIBINPUT
	select BR2_PACKAGE_FONTCONFIG
	select BR2_PACKAGE_FONT_INTER
	select BR2_PACKAGE_FONT_MATERIAL_SYMBOLS
	help
	  mestro — the Music Assistant player. Built from this
	  repository with Buildroot's Rust toolchain, with the kiosk
	  features (linuxkms, ota, wifi-setup, audio-output, timezone);
	  see image/README.md. The dependencies are the binary's
	  runtime libs (libseat, libxkbcommon, libudev, libinput,
	  libgbm, libfontconfig); the GL stack providing libgbm is
	  selected by the board config.
```

## image/package/rpi-tryboot/Config.in
```kconfig
config BR2_PACKAGE_RPI_TRYBOOT
	bool "rpi-tryboot"
	help
	  Reboot into the Raspberry Pi firmware's one-shot tryboot
	  mode — the trial boot behind mestro-upgrade's A/B slots.
```
